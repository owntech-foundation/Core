## zephyr/boards/owntech/spin/board.yml
```yaml
# Copyright (c) 2024 OwnTech
# SPDX-License-Identifier: LGPL-2.1

board:
  name: spin
  full_name: OwnTech Spin
  vendor: owntech
  socs:
    - name: stm32g474xx
```

## zephyr/dts/bindings/motor-config.yaml
```yaml
description: Default motor configuration shared by position sensors

compatible: "motor-config"

properties:
  pole-pairs:
    type: int
    required: false
    description: Number of motor pole pairs.
```

## zephyr/dts/bindings/shield-position-abz.yaml
```yaml
description: Incremental encoder wiring and default configuration exposed by a shield

compatible: "shield-position-abz"

properties:
  position-sensor-name:
    type: string
    required: true
    description: Name under which the position sensor is referred to in user code.

  motor:
    type: phandle
    required: false
    description: Optional reference to the default motor configuration node.

  direction-sign:
    type: int
    required: false
    description: Direction convention used by this position sensor, typically 1 or -1.

  electrical-offset:
    type: int
    required: false
    description: Electrical offset for this position sensor, stored as an IEEE754 float32 bit pattern.

  timer:
    type: phandle
    required: true
    description: Timer instance used in incremental encoder mode.

  counts-per-revolution:
    type: int
    required: false
    description: Counts per revolution of this incremental encoder.
```

## zephyr/dts/bindings/shield-position-hall.yaml
```yaml
description: Hall position sensor wiring and default configuration exposed by a shield

compatible: "shield-position-hall"

properties:
  position-sensor-name:
    type: string
    required: true
    description: Name under which the position sensor is referred to in user code.

  motor:
    type: phandle
    required: false
    description: Optional reference to the default motor configuration node.

  direction-sign:
    type: int
    required: false
    description: Direction convention used by this position sensor, typically 1 or -1.

  electrical-offset:
    type: int
    required: false
    description: Electrical offset for this position sensor, stored as an IEEE754 float32 bit pattern.

  hall-a-gpios:
    type: phandle-array
    required: true
    description: Hall channel A GPIO.

  hall-b-gpios:
    type: phandle-array
    required: true
    description: Hall channel B GPIO.

  hall-c-gpios:
    type: phandle-array
    required: true
    description: Hall channel C GPIO.

  hall-sector-table:
    type: array
    required: false
    description: Hall-state to sector mapping table with 6 entries for raw states 001 to 110. Invalid states 000 and 111 are handled by the driver.

  hall-interpolation:
    type: string
    required: false
    description: Default Hall interpolation mode.
```

## zephyr/dts/bindings/shield-position-sincos.yaml
```yaml
description: Sin/Cos position sensor wiring and default configuration exposed by a shield

compatible: "shield-position-sincos"

properties:
  position-sensor-name:
    type: string
    required: true
    description: Name under which the position sensor is referred to in user code.

  motor:
    type: phandle
    required: false
    description: Optional reference to the default motor configuration node.

  direction-sign:
    type: int
    required: false
    description: Direction convention used by this position sensor, typically 1 or -1.

  electrical-offset:
    type: int
    required: false
    description: Electrical offset for this position sensor, stored as an IEEE754 float32 bit pattern.

  sin-spin-pin:
    type: int
    required: true
    description: Spin header pin used for the analog sine channel.

  cos-spin-pin:
    type: int
    required: true
    description: Spin header pin used for the analog cosine channel.

  sin-sensor-name:
    type: string
    required: true
    description: Matching shield sensor name used to acquire the analog sine channel.

  cos-sensor-name:
    type: string
    required: true
    description: Matching shield sensor name used to acquire the analog cosine channel.
```

## zephyr/dts/bindings/shield-sensors.yaml
```yaml
description: List of a shield sensors that can be acquired by Spin ADCs

compatible: "shield-sensors"

properties:
  sensor-name:
    type: string
    required: true
    description: Name under which the sensor will be referred to in user code.

  default-gain:
    type: int
    required: false
    description: Value of the gain (multiplication to be applied on the raw measured value).
                 The value represents a float32_t, thus is stored in IEEE754 format.

  default-offset:
    type: int
    required: false
    description: Value of the offset (to be added after the raw value has been multiplied by the gain).
                 The value represents a float32_t, thus is stored in IEEE754 format.

  default-r0:
    type: int
    required: false
    description: Value of the resistance of the thermistor at a reference temperature.

  default-b:
    type: int
    required: false
    description: Value of the coefficient of resistance change with temperature of the thermistor
                 material.

  default-rdiv:
    type: int
    required: false
    description: Value of the resistance used in the bridge to condition the temperature measurement.

  default-t0:
    type: int
    required: false
    description: Value of the offset (to be added after the raw value has been multiplied by the gain).
                 The value represents a float32_t, thus is stored in IEEE754 format.


  mux-spin-pin-1:
    type: int
    required: false
    description: PIN IN 1 used in the mux for temperature sensor on the Ownverter. 

  mux-spin-pin-2:
    type: int
    required: false
    description: PIN IN 1 used in the mux for temperature sensor on the Ownverter. 


  default-adc:
    type: string
    required: false
    default: "UNKNOWN_ADC"
    enum:
      - "UNKNOWN_ADC"
      - "ADC_1"
      - "ADC_2"
      - "ADC_3"
      - "ADC_4"
      - "ADC_5"
    description: Default ADC used for acquisition by enableDefaultSensors().
                 UNKNOWN_ADC means the sensor is not enabled by default.

  default-order:
    type: int
    required: false
    default: 255
    description: Position in the enableDefaultSensors() acquisition sequence.
                 Lower values are enabled first, determining the per-ADC channel
                 order. Only meaningful when default-adc is not UNKNOWN_ADC.
                 Sensors without this property (default 255) are not ordered.

  sensor-conv-type:
    type: string
    required: false
    description: Type of conversion performed by the sensor. Typically LINEAR or LOG.


child-binding:

  description: Sensor node ADC info

  properties:

    io-channels:
      type: phandle-array
      required: true
      description: ADC number and channel description.

    spin-pin:
      type: int
      required: true

    differential:
      type: boolean
      required: false
      description: Set the channel to differential mode. Default is Single Ended.
```

## zephyr/modules/owntech_shield_api/zephyr/Kconfig
```kconfig
config OWNTECH_SHIELD_API
	bool "Enable OwnTech Shield API"
	default y
	depends on OWNTECH_SPIN_API
	depends on HAS_POWER_SHIELD
	help
		This module provides functions to interact with Spin shields.

config OWNTECH_POWER_DUTY_SEQ_MAX_LEN
	int "Maximum number of values in a leg duty-cycle sequence"
	default 64
	range 1 1024
	depends on OWNTECH_SHIELD_API
	help
		Size of the per-leg buffers used by PowerAPI::setDutySequence().
		Each leg enabled in the device tree reserves 16 bytes per value
		(float copy, staging and two DMA copies for double buffering).
```

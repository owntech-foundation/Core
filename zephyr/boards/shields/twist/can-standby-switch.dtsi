/*
 * Copyright (c) 2022-2024 OwnTech.
 *
 * SPDX-License-Identifier: LGPL-2.1
 */

/ {
	can-standby-switch {
		compatible = "gpio-device";
		can-standby-gpio-pin {
			gpios = <&spin_header 14 GPIO_ACTIVE_HIGH>;
		};
	};
};

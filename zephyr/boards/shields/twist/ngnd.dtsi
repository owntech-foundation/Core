/*
 * Copyright (c) 2022-2024 OwnTech.
 *
 * SPDX-License-Identifier: LGPL-2.1
 */

 / {
	ngnd: ngnd-switch {
		compatible = "gpio-device";
		ngnd-gpio-pin {
			gpios = <&spin_header 1 GPIO_ACTIVE_HIGH>;
		};
	};
};

/*
 * Copyright (c) 2022 OwnTech.
 *
 * SPDX-License-Identifier: LGLPV2.1
 */

 / {
	soc {
		adc3: adc@50005000 {
			compatible = "st,stm32-adc";
			reg = < 0x50005000 0x100 >;
			clocks = < &rcc STM32_CLOCK_BUS_AHB2 0x00004000 >;
			interrupts = < 18 0x0 >;
			status = "disabled";
			label = "ADC_3";
			#io-channel-cells = < 0x1 >;
		};

		adc4: adc@50005100 {
			compatible = "st,stm32-adc";
			reg = < 0x50005100 0x100 >;
			clocks = < &rcc STM32_CLOCK_BUS_AHB2 0x00004000 >;
			interrupts = < 18 0x0 >;
			status = "disabled";
			label = "ADC_4";
			#io-channel-cells = < 0x1 >;
		};
	};
};
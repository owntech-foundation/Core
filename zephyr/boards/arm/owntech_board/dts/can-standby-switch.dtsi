/*
 * Copyright (c) 2022 OwnTech.
 *
 * SPDX-License-Identifier: LGLPV2.1
 */

/ {
	can-standby-switch {
		compatible = "gpio-device";
		can-standby-gpio-pin {
			gpios = <&gpiob 10 GPIO_ACTIVE_HIGH>;
			label = "CAN Standby output";
		};
	};
};
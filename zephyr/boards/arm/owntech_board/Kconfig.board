## zephyr/boards/arm/owntech_board/Kconfig.board
```kconfig
# OwnTech board configuration

config BOARD_OWNTECH_BOARD
	bool "OwnTech Power Converter board"
	depends on SOC_STM32G474XX
```

## zephyr/boards/arm/owntech_board/Kconfig.defconfig
```kconfig
# OwnTech board configuration

if BOARD_OWNTECH_BOARD

config BOARD
	default "owntech_board"

config SPI_STM32_INTERRUPT
	default y
	depends on SPI

endif # BOARD_OWNTECH_BOARD
```

## zephyr/boards/arm/owntech_board/dts/bindings/can-standby-switch.yaml
```yaml
description: CAN Standby Switch

compatible: "can-standby-switch"

child-binding:
  description: CAN Stanby GPIO node
  properties:
    can-standby-gpios:
      type: phandle-array
      required: true
    label:
      required: true
      type: string
      description: Human readable string describing the device (used as device_get_binding() argument)
```

## zephyr/boards/arm/owntech_board/dts/bindings/gpio-device.yaml
```yaml
description: GPIO-controllable device

compatible: "gpio-device"

child-binding:
  description: GPIO node
  properties:
    gpios:
      type: phandle-array
      required: true
    label:
      required: true
      type: string
      description: Human-readable string describing the pin function
```

## zephyr/boards/arm/owntech_board/dts/bindings/hrtim.yaml
```yaml
description: HRTIM outputs

compatible: "hrtim"

include: base.yaml

properties:
  pinctrl-0:
    type: phandles
    required: false
    description: |
      GPIO pin configuration for HRTIM outputs.
      The phandles have to reference pinctrl nodes, e.g.

      pinctrl-0 = <&hrtim1_cha1_pa8 &hrtim1_cha2_pa9>;
```

## zephyr/boards/arm/owntech_board/dts/bindings/ngnd-switch.yaml
```yaml
description: Neutral-Ground Switch

compatible: "ngnd-switch"

child-binding:
    description: Neutral-Ground GPIO node
    properties:
       ngnd-gpios:
          type: phandle-array
          required: true
       label:
          required: true
          type: string
          description: Human readable string describing the device (used as device_get_binding() argument)
```

## zephyr/boards/arm/spin/Kconfig.board
```kconfig
# Copyright (c) 2023 OwnTech
# SPDX-License-Identifier: LGPL-2.1

# OwnTech board Kconfig definition

config BOARD_SPIN
	bool "OwnTech Spin"
	depends on SOC_STM32G474XX
```

## zephyr/boards/arm/spin/Kconfig.defconfig
```kconfig
# Adapted from original file: Zephyr's G474RE Kconfig.defconfig
# zephyr/boards/arm/nucleo_g474re/Kconfig.defconfig
# Copyright (c) 2019 STMicroelectronics.
# This file copyright OwnTech 2023

# SPDX-License-Identifier: Apache-2.0

# OwnTech board configuration

if BOARD_SPIN

config BOARD
	default "owntech_spin"

config SPI_STM32_INTERRUPT
	default y
	depends on SPI

endif # BOARD_SPIN
```

## zephyr/boards/arm/spin/spin_defconfig
```kconfig
# Copyright (c) 2022-2023 OwnTech
# SPDX-License-Identifier: LGLPV2.1

# Spin default Kconfig configuration


CONFIG_SOC_SERIES_STM32G4X=y
CONFIG_SOC_STM32G474XX=y

# Enable UART driver
CONFIG_SERIAL=y

# Enable pin control
CONFIG_PINCTRL=y

# Enable GPIO
CONFIG_GPIO=y

# Enable Clocks
CONFIG_CLOCK_CONTROL=y

# Console
CONFIG_CONSOLE=y
CONFIG_UART_CONSOLE=y

# Enable MPU
CONFIG_ARM_MPU=y

# Enable HW stack protection
CONFIG_HW_STACK_PROTECTION=y
```

## zephyr/boards/nucleo_g474re.conf
```kconfig
# Copyright (c) 2024 OwnTech
# SPDX-License-Identifier: LGPL-2.1

# Enable and configure USB
CONFIG_USB_DEVICE_STACK=y

# Enable flash
CONFIG_FLASH=y
```

## zephyr/boards/owntech/spin/Kconfig.defconfig
```kconfig
# Adapted from original file: Zephyr's G474RE Kconfig.defconfig
# zephyr/boards/st/nucleo_g474re/Kconfig.defconfig
# Copyright (c) 2019 STMicroelectronics.
# This file copyright OwnTech 2023-2024

# SPDX-License-Identifier: Apache-2.0

# OwnTech board configuration
# This file is automatically merged into the
# the KConfig configuration to provide defaults.

if BOARD_SPIN

config SPI_STM32_INTERRUPT
	default y
	depends on SPI

config HAS_POWER_SHIELD
	def_bool SHIELD_O2 || SHIELD_OWNVERTER || SHIELD_TWIST

endif # BOARD_SPIN
```

## zephyr/boards/owntech/spin/spin_defconfig
```kconfig
# Copyright (c) 2022-2023 OwnTech
# SPDX-License-Identifier: LGPL-2.1

# Spin default Kconfig configuration

# Enable Clocks
CONFIG_CLOCK_CONTROL=y

# Enable pin control
CONFIG_PINCTRL=y

# Enable GPIO
CONFIG_GPIO=y

# Enable UART
CONFIG_SERIAL=y

# Enable and configure USB
CONFIG_USB_DEVICE_STACK=y
CONFIG_USB_DEVICE_MANUFACTURER="OwnTech Technologies"
CONFIG_USB_DEVICE_PRODUCT="SPIN"

# Enable flash
CONFIG_FLASH=y

# Console
CONFIG_CONSOLE=y
CONFIG_UART_CONSOLE=y

# Enable MPU
CONFIG_ARM_MPU=y

# Enable HW stack protection
CONFIG_HW_STACK_PROTECTION=y
```

## zephyr/boards/shields/LFE/Kconfig.shield
```kconfig
# Copyright (c) 2023 OwnTech
# SPDX-License-Identifier: LGPL-2.1

config SHIELD_LFE_DEMO
	def_bool $(shields_list_contains,lfe_demo_v0_0_1) || \
			 $(shields_list_contains,lfe_demo)

config SHIELD_LFE_DEMO_V0_0_1
	def_bool $(shields_list_contains,lfe_demo_v0_0_1)

config HAS_POWER_SHIELD
	default y
	bool "Our protoboard shield for LFE Conference 2024"
```

## zephyr/boards/shields/o2/Kconfig.shield
```kconfig
# Copyright (c) 2023 OwnTech
# SPDX-License-Identifier: LGPL-2.1

config SHIELD_O2
	def_bool $(shields_list_contains,o2_v1_1_2)
```

## zephyr/boards/shields/ownverter/Kconfig.shield
```kconfig
# Copyright (c) 2023 OwnTech
# SPDX-License-Identifier: LGPL-2.1

config SHIELD_OWNVERTER
	def_bool $(shields_list_contains,ownverter_v1_1_0) || \
			 $(shields_list_contains,ownverter_v1_0_0) || \
			 $(shields_list_contains,ownverter_v0_9_0) || \
			 $(shields_list_contains,ownverter)
```

## zephyr/boards/shields/twist/Kconfig.shield
```kconfig
# Copyright (c) 2023 OwnTech
# SPDX-License-Identifier: LGPL-2.1

config SHIELD_TWIST
	def_bool $(shields_list_contains,twist_v1_4_2) || \
			 $(shields_list_contains,twist_v1_4_1) || \
			 $(shields_list_contains,twist_v1_4_0) || \
			 $(shields_list_contains,twist_v1_3_0) || \
			 $(shields_list_contains,twist_v1_2_0) || \
			 $(shields_list_contains,twist)

config SHIELD_TWIST_V1_4_2
	def_bool $(shields_list_contains,twist_v1_4_2)

config SHIELD_TWIST_V1_4_1
	def_bool $(shields_list_contains,twist_v1_4_1)

config SHIELD_TWIST_V1_4_0
	def_bool $(shields_list_contains,twist_v1_4_0)

config SHIELD_TWIST_V1_3_0
	def_bool $(shields_list_contains,twist_v1_3_0)

config SHIELD_TWIST_V1_2_0
	def_bool $(shields_list_contains,twist_v1_2_0)
```

## zephyr/dts/bindings/adc-channels.yaml
```yaml
description: List of channels connected to ADCs that can be acquired by OwnTech Data Acquisition

compatible: "adc-channels"

properties:
  channel-name:
    type: string
    required: true
    description: Name under which the channel will be referred to in user code.

  default-gain:
    type: int
    required: false

  default-offset:
    type: int
    required: false

  spin-pin:
    type: int
    required: true


child-binding:

  description: Channel node ADC info

  properties:

    io-channels:
      type: phandle-array
      required: true
      description: ADC number and channel description.

    differential:
      type: boolean
      required: false
      description: Set the channel to differential mode. Default is Single Ended.
```

## zephyr/dts/bindings/adc-inputs.yaml
```yaml
# SPDX-License-Identifier: Apache-2.0
# Copyright (c) 2020 Martin Jäger / Libre Solar

description: Description for an ADC input including gain (multiplier/divider) and offset

compatible: "adc-inputs"

child-binding:
  description: ADC inputs child node
  properties:
    io-channels:
      type: phandle-array
      required: true
      description: |
        ADC channel for this input.

    differential:
      type: boolean
      required: false
      description: |
        Set the io-channels to differential mode. Default is Single Ended    

    enable-gpios:
      type: phandle-array
      required: false
      description: |
        Enable the voltage divider input or amplifier.

        If present the corresponding GPIO must be set to an active level
        to enable the divider input.

    label:
      required: true
      type: string
      description: Human-readable string describing the channel acquirred data
```

## zephyr/dts/bindings/gpio-device.yaml
```yaml
description: GPIO-controllable device

compatible: "gpio-device"

child-binding:
  description: GPIO node
  properties:
    gpios:
      type: phandle-array
      required: true
```

## zephyr/dts/bindings/gpio/spin-header.yaml
```yaml
# Copyright (c) 2023 OwnTech
# SPDX-License-Identifier: LGLPV2.1

description: |
    GPIO pins exposed on OwnTech Spin headers.

    The OwnTech Spin board provides 6 headers:
    * 3 around the external egde of the board,
    * 4 within the board.

    Proceeding counter-clockwise:
    * A 20-pin header on the external left of the board, numbered from 1 to 20 top to bottom.
      Pins 3, 8, 13 and 18 are GND, thus not exposed in this binding.
    * A 20-pin header on the external right of the board, numbered from 21 to 40 bottom to top.
      Pins 23, 28, 33 and 38 are GND, while pins 36, 39 and 40 are voltage, thus not
      exposed in this binding.
    * A 5-pin header on the internal top left of the board, numbered from 41 to 45.
    * A 7-pin header on the internal bottom left of the board, numbered from 46 to 52.
    * A 6-pin header on the bottom of the board, numbered from 53 to 58.
      Pins 54 and 57 are GND, thus not exposed in this binding.
    * A 1-pin header on the internal bottom right of the board, numbered 59.


    This binding provides a nexus mapping for 46 pins.
    Pins not described in this map are displayed between curly brackets.

    ----------------------------------
    |  1                         (40)|
    |  2                         (39)|
    | (3)                        (38)|
    |  4  41                      37 |
    |  5  42                     (36)|
    |  6  43                      35 |
    |  7  44                      34 |
    | (8) 45                     (33)|
    |  9                          32 |
    | 10                          31 |
    | 11                          30 |
    | 12                          29 |
    |(13) 46                     (28)|
    | 14  47                      27 |
    | 15  48                      26 |
    | 16  49                      25 |
    | 17  50                      24 |
    |(18) 51                     (23)|
    | 19  52                  59  22 |
    | 20  53 (54) 55  56 (57) 58  21 |
    ----------------------------------

compatible: "spin-header"

include: [gpio-nexus.yaml, base.yaml]
```

## zephyr/dts/bindings/hrtim.yaml
```yaml
description: HRTIM binding

compatible: "hrtim"

include: [base.yaml, pinctrl-device.yaml, reset-device.yaml]

properties:
  reg:
    required: true

  clocks:
    required: true

  resets:
    required: true

  st,prescaler:
    type: int
    required: true
    description: |
      Clock prescaler at the input of the timer
      Could be in range [0 .. 0xFFFF] for STM32 General Purpose Timers (CLK/(prescaler+1) )

  st,countermode:
    type: int
    default: 0 # STM32_TIM_COUNTERMODE_UP - reset state
    description: |
      Sets timer counter mode.

      Use constants defined in dt-bindings/timer/stm32-timer.h.

      * STM32_TIM_COUNTERMODE_UP             - used as upcounter.
      * STM32_TIM_COUNTERMODE_DOWN           - used as downcounter.
      * STM32_TIM_COUNTERMODE_CENTER_DOWN    - counts up and down alternatively.
                                               Output compare interrupt flags of output channels
                                               are set only when the counter is counting down.
      * STM32_TIM_COUNTERMODE_CENTER_UP      - counts up and down alternatively.
                                               Output compare interrupt flags of output channels
                                               are set only when the counter is counting up.
      * STM32_TIM_COUNTERMODE_CENTER_UP_DOWN - counts up and down alternatively.
                                               Output compare interrupt flags of output channels
                                               are set only when the counter is counting up or
                                               down.

      If absent, then STM32_TIM_COUNTERMODE_UP is used (reset state).

child-binding:

  description : pwm child bindings are used to connect the spin board to a shield 

  properties : 

    "#pwm-cells":
      const: 2
      type: int
      required: false
      description: |
        Number of items to expect in a PWM
        - channel of the timer used for PWM
        - flags : polarity flag like PWM_POLARITY_NORMAL
          or PWM_POLARITY_INVERTED

    pinctrl-0:
      type: phandles
      required: false
      description: |
        GPIO pin configuration for HRTIM outputs.
        The phandles have to reference pinctrl nodes, e.g.
        pinctrl-0 = <&hrtim1_cha1_pa8 &hrtim1_cha2_pa9>;

  pwm-cells:
    - channel
    - flags
```

## zephyr/dts/bindings/ngnd-gpio.yaml
```yaml
description: GPIO parent node

compatible: "ngnd-gpio"

child-binding:
    description: NGND GPIO child node
    properties:
       gpios:
          type: phandle-array
          required: true
       label:
          required: true
          type: string
          description: Human readable string describing the device (used as device_get_binding() argument)
```

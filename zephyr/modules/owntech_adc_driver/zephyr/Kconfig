## zephyr/modules/owntech_adc_driver/zephyr/Kconfig
```kconfig
config OWNTECH_ADC_DRIVER
	bool "Enable OwnTech ADC driver for STM32"
	default y
	depends on !ADC
	help
		This module implements an ad-hoc ADC driver for Zephyr that
		provides features required by OwnTech Power API.
		It replaces Zephyr's default ADC module in Power API.
```

## zephyr/modules/owntech_communication/zephyr/Kconfig
```kconfig
config OWNTECH_COMMUNICATION
	bool "Enable OwnTech communication module [EXPERIMENTAL]"
	# OwnTech Communication API in still experimental: disable by default
	default n
	depends on OWNTECH_SHIELD_API
	help
		This experimental module provides various ways of communicating
		(CAN, RS485, analog) for OwnTech Power API.
		It is an experimental module still not ready for production.

if OWNTECH_COMMUNICATION

	config OWNTECH_COMMUNICATION_ENABLE_ANALOG
		bool "Enable Analog communication API"
		default y

	config OWNTECH_COMMUNICATION_ENABLE_CAN
		bool "Enable CAN bus communication API (Thingset over CAN)"
		default n
		depends on CAN
		depends on ISOTP
		depends on THINGSET
		depends on OWNTECH_DATA_API

	config OWNTECH_COMMUNICATION_ENABLE_RS485
		bool "Enable RS485 bus communication API"
		default y

	config OWNTECH_COMMUNICATION_ENABLE_SYNC
		bool "Enable synchronization API"
		default y

endif
```

## zephyr/modules/owntech_comparator_driver/zephyr/Kconfig
```kconfig
config OWNTECH_COMPARATOR_DRIVER
	bool "Enable OwnTech comparator driver for STM32"
	default y
	help
		This module provides an ad-hoc Comparator driver for Zephyr that
		contains features required by OwnTech Power API.
```

## zephyr/modules/owntech_dac_driver/zephyr/Kconfig
```kconfig
config OWNTECH_DAC_DRIVER
	bool "Enable OwnTech DAC driver"
	default y
	depends on !DAC
	help
		This module implements an ad-hoc DAC driver for Zephyr that
		provides features required by OwnTech Power API.
		It replaces Zephyr's default DAC module in Power API.
```

## zephyr/modules/owntech_data_acquisition/zephyr/Kconfig
```kconfig
config OWNTECH_DATA_ACQUISITION
	bool "Enable OwnTech data acquisition using ADCs"
	default y
	select DMA
	depends on CONSOLE_GETCHAR
	depends on OWNTECH_HARDWARE_CONFIGURATION
	help
		Data Acquisition is an OwnTech Power API module that provides
		means of automatically gathering data from Spin board ADCs.
		It also interfaces with the Twist shield, providing	ways to
		interact with the sensors available on the shield and converting
		raw data in their relevant unit.
```

## zephyr/modules/owntech_data_api/zephyr/Kconfig
```kconfig
config OWNTECH_DATA_API
	bool "Enable OwnTech data acquisition using ADCs"
	default y
	select DMA
	depends on CONSOLE_GETCHAR
	depends on OWNTECH_SPIN_API
	depends on OWNTECH_FLASH
	help
		The data API provides a framework for automatically gathering
		data from Spin board ADCs into buffers which can be auto generated.
		It also interfaces with the Twist shield, providing	ways to
		interact with the sensors available on the shield and converting
		raw data in their relevant unit.
```

## zephyr/modules/owntech_gpio_api/zephyr/Kconfig
```kconfig
config OWNTECH_GPIO_API
	bool "Enable OwnTech GPIO API"
	default y
	help
		GPIO API provides ways to interact with Spin
		GPIO by referencing them by their name, either
		by using Spin nexus or STM32-style names.
```

## zephyr/modules/owntech_hardware_configuration/zephyr/Kconfig
```kconfig
config OWNTECH_HARDWARE_CONFIGURATION
	bool "Enable OwnTech hardware configuration module"
	default y
	depends on OWNTECH_ADC_DRIVER
	depends on OWNTECH_DAC_DRIVER
	depends on OWNTECH_HRTIM_DRIVER
	depends on OWNTECH_TIMER_DRIVER
	depends on OWNTECH_GPIO_API
	depends on OWNTECH_COMPARATOR_DRIVER
	depends on OWNTECH_NGND_DRIVER || !SHIELD_TWIST
	help
		Hardware Configuration is a module that provides
		an hardware abstraction layer (HAL) for OwnTech's
		Spin board and Twist shield.
		It abstracts base drivers by providing an object-based,
		user-friendly API.
```

## zephyr/modules/owntech_hrtim_driver/zephyr/Kconfig
```kconfig
config OWNTECH_HRTIM_DRIVER
	bool "Enable OwnTech High-resolution timer driver for STM32"
	default y
	select USE_STM32_LL_GPIO
	help
		This module provides an ad-hoc High-Resolution Timer driver for
		Zephyr that contains features required by OwnTech Power API.
```

## zephyr/modules/owntech_ngnd_driver/zephyr/Kconfig
```kconfig
config OWNTECH_NGND_DRIVER
	bool "Enable OwnTech ngnd driver"
	default y
	depends on SHIELD_TWIST
	help
		This module provides a Zephyr driver that allows
		to drive the Neutral-Ground switch present on older
		versions of the OwnTech Twist shield and O2 board.
```

## zephyr/modules/owntech_power_api/zephyr/Kconfig
```kconfig
config OWNTECH_POWER_API
	bool "Enable OwnTech power API for the STM32G474RE microcontroller"
	default y
	help
		The Power API module provides functionalities that
		allow to drive the various modes of a power converter.
```

## zephyr/modules/owntech_safety_api/zephyr/Kconfig
```kconfig
config OWNTECH_SAFETY_API
	bool "Enable OwnTech safety measures to protect the board"
	default y
	depends on OWNTECH_SHIELD_API
```

## zephyr/modules/owntech_scheduling/zephyr/Kconfig
```kconfig
config OWNTECH_SCHEDULING
	bool "Enable OwnTech scheduling"
	default y
	depends on OWNTECH_TIMER_DRIVER
	depends on OWNTECH_HRTIM_DRIVER
	depends on OWNTECH_DATA_ACQUISITION

if OWNTECH_SCHEDULING

	config OWNTECH_SCHEDULING_ENABLE_ASYNCHRONOUS_TASKS
		bool "Enable support for asychronous tasks"
		help
			Asynchronous tasks are run in background when no synchronous task is running.
		default y

	config OWNTECH_SCHEDULING_MAX_ASYNCHRONOUS_TASKS
		int "Maximum number of asychronous tasks"
		help
			The higher this value, the more RAM will be reserved for tasks and unavailable to the main program.
		default 3
		range 1 5

	config OWNTECH_SCHEDULING_ASYNCHRONOUS_TASKS_STACK_SIZE
		int "Stack size for asynchronous threads"
		default 512

endif
```

## zephyr/modules/owntech_spin_api/zephyr/Kconfig
```kconfig
config OWNTECH_SPIN_API
	bool "Enable OwnTech Spin API"
	default y
	depends on OWNTECH_ADC_DRIVER
	depends on OWNTECH_DAC_DRIVER
	depends on OWNTECH_HRTIM_DRIVER
	depends on OWNTECH_TIMER_DRIVER
	depends on OWNTECH_COMPARATOR_DRIVER
	depends on CONSOLE_GETCHAR
	depends on OWNTECH_FLASH
	help
		The SPIN API is a module that aggregates all the drivers of
		the STM32G474RE of the Spin board within a single object.
		This abstracts base drivers by providing an object-based,
		user-friendly API.

if OWNTECH_SPIN_API

	config OWNTECH_GPIO_API
		bool "Enables the OwnTech GPIO API integrated with the Spin Board"
		default y
		depends on OWNTECH_SPIN_API
		help
			The GPIO API provides ways to interact with Spin
			GPIO by referencing them by their name, either
			by using Spin nexus or STM32-style names.

	config OWNTECH_UART_API
	bool "Enable OwnTech UART API"
	default n
	help
		The UART API is a module that aggregates basic UART functionality
		for shields that supports it.

endif
```

## zephyr/modules/owntech_task_api/zephyr/Kconfig
```kconfig
config OWNTECH_TASK_API
	bool "Enable OwnTech scheduling"
	default y
	depends on OWNTECH_TIMER_DRIVER
	depends on OWNTECH_HRTIM_DRIVER

if OWNTECH_TASK_API

	config OWNTECH_TASK_ENABLE_ASYNCHRONOUS_TASKS
		bool "Enable support for asychronous tasks"
		help
			Asynchronous tasks are run in background when no synchronous task is running.
		default y

	config OWNTECH_TASK_MAX_ASYNCHRONOUS_TASKS
		int "Maximum number of asychronous tasks"
		help
			The higher this value, the more RAM will be reserved for tasks and unavailable to the main program.
		default 3
		range 1 5

	config OWNTECH_TASK_ASYNCHRONOUS_TASKS_STACK_SIZE
		int "Stack size for asynchronous threads"
		default 1024

endif
```

## zephyr/modules/owntech_timer_driver/zephyr/Kconfig
```kconfig
config OWNTECH_TIMER_DRIVER
	bool "Enable timer driver by OwnTech (only STM32 timer partial support for now)"
	default y
	select DYNAMIC_INTERRUPTS
	select USE_STM32_LL_TIM # Required to add LL timer source file to compile path
	help
		This module provides an ad-hoc Timer driver for Zephyr that
		contains features required by OwnTech Power API.
```

## zephyr/modules/owntech_vrefbuf_driver/zephyr/Kconfig
```kconfig
config OWNTECH_VREFBUF_DRIVER
	bool "Enable OwnTech VREFBUF driver for STM32"
	default y
```
